## .devcontainer/west.yml
```yaml
manifest:
  projects:
    - name: nrf
      url: https://github.com/nrfconnect/sdk-nrf
      revision: v2.5.0
      import:
        name-allowlist:
          - bsim
          - zephyr
          - cmsis
          - nrfxlib
          - mcuboot
          - mcumgr
          - tinycbor
          - segger
          - tinycrypt
          - hal_nordic
```

## fw/boards/arm/esl/Kconfig.board
```kconfig
config BOARD_ESL
	bool "Electronic Self-Label board"
	depends on SOC_NRF52840_QIAA
```

## fw/boards/arm/esl/Kconfig.defconfig
```kconfig
if BOARD_ESL

# No DCDC support components: if we enable this, the chip
# will brick itself upon reboot.
config BOARD_ENABLE_DCDC
	bool
	default n

config GPIO_AS_PINRESET
	default n

if BOARD_SERIAL_BACKEND_CDC_ACM

config USB_DEVICE_STACK
	default y

config USB_CDC_ACM
	default y

config UART_CONSOLE
	default CONSOLE

config USB_DEVICE_INITIALIZE_AT_BOOT
	default y if !MCUBOOT

config SHELL_BACKEND_SERIAL_CHECK_DTR
	default SHELL

config USB_DEVICE_REMOTE_WAKEUP
	default n

if LOG

# Logger cannot use itself to log
choice USB_CDC_ACM_LOG_LEVEL_CHOICE
	default USB_CDC_ACM_LOG_LEVEL_OFF
endchoice

# Set USB log level to error only
choice USB_DEVICE_LOG_LEVEL_CHOICE
	default USB_DEVICE_LOG_LEVEL_ERR
endchoice

# Wait 4000ms at startup for logging
config LOG_PROCESS_THREAD_STARTUP_DELAY_MS
	default 4000

endif # LOG

if USB_DEVICE_STACK

# Enable UART driver, needed for CDC ACM
config SERIAL
	default y

endif # USB_DEVICE_STACK

endif # BOARD_SERIAL_BACKEND_CDC_ACM

config BOARD
	default "esl"

endif
```

## fw/boards/arm/esl/esl_defconfig
```kconfig
# SPDX-License-Identifier: Apache-2.0

CONFIG_SOC_SERIES_NRF52X=y
CONFIG_SOC_NRF52840_QIAA=y

CONFIG_BOARD_ESL=y

# Enable MPU
CONFIG_ARM_MPU=y

# Enable hardware stack protection
CONFIG_HW_STACK_PROTECTION=y

# Enable RTT
CONFIG_USE_SEGGER_RTT=y
CONFIG_USE_SEGGER_RTT=y
CONFIG_SEGGER_RTT_BUFFER_SIZE_UP=4096

# enable logging over RTT
CONFIG_LOG=y
CONFIG_LOG_BACKEND_RTT=y

# enable GPIO
CONFIG_GPIO=y
CONFIG_NFCT_PINS_AS_GPIOS=y

# enable console
CONFIG_CONSOLE=y
CONFIG_RTT_CONSOLE=y

CONFIG_PINCTRL=y

# We don't have a crystal mounted
CONFIG_CLOCK_CONTROL_NRF_K32SRC_RC=y

CONFIG_LED=y
CONFIG_LED_GPIO=y

CONFIG_USB_DEVICE_MANUFACTURER="DRAGOON"
CONFIG_USB_DEVICE_PRODUCT="Electronic Self Label"
CONFIG_USB_DEVICE_SN="00000001"

CONFIG_USB_DEVICE_PID=0xbad9
CONFIG_USB_DEVICE_VID=0x1915

# console over USB CDC-ACM
CONFIG_USB_DEVICE_STACK=y
CONFIG_USB_DEVICE_INITIALIZE_AT_BOOT=n

CONFIG_SERIAL=y
CONFIG_UART_LINE_CTRL=y

# -----------------------------------------
# flash
CONFIG_FLASH=y
CONFIG_SPI_NOR=y
# CONFIG_SPI_NOR_SFDP_RUNTIME=y
# CONFIG_SPI_NOR_IDLE_IN_DPD=y

# -----------------------------------------
# BT SHELL CONFIG
# Increased stack due to settings API usage
CONFIG_SYSTEM_WORKQUEUE_STACK_SIZE=4096
CONFIG_MAIN_STACK_SIZE=2048
CONFIG_BT_RX_STACK_SIZE=2048

CONFIG_BT_CTLR=y
CONFIG_TEST=y
CONFIG_TEST_LOGGING_DEFAULTS=n
CONFIG_BT=y
CONFIG_LOG=y
CONFIG_BT_CENTRAL=y
CONFIG_BT_PERIPHERAL=y
CONFIG_BT_PRIVACY=y
CONFIG_BT_ATT_PREPARE_COUNT=2
CONFIG_BT_SHELL=y
CONFIG_BT_DEVICE_NAME="Electronic Self-Label"
CONFIG_BT_DEVICE_NAME_DYNAMIC=y
CONFIG_BT_L2CAP_TX_BUF_COUNT=4
CONFIG_BT_ID_MAX=2
CONFIG_BT_HRS=y
CONFIG_BT_FILTER_ACCEPT_LIST=y
CONFIG_BT_REMOTE_INFO=y
CONFIG_BT_REMOTE_VERSION=y
CONFIG_BT_GATT_AUTO_DISCOVER_CCC=y

CONFIG_BT_EXT_ADV=y
CONFIG_BT_EXT_ADV_LEGACY_SUPPORT=y

CONFIG_BT_USER_DATA_LEN_UPDATE=y
CONFIG_BT_AUTO_DATA_LEN_UPDATE=y

CONFIG_BT_USER_PHY_UPDATE=y
CONFIG_BT_AUTO_PHY_UPDATE=y

# Errno message table. Disable to save ROM.
CONFIG_MINIMAL_LIBC_STRING_ERROR_TABLE=y
```
